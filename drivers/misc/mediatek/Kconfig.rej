## drivers/misc/mediatek/Kconfig.rej
```kconfig
--- drivers/misc/mediatek/Kconfig
+++ drivers/misc/mediatek/Kconfig
@@ -412,42 +439,63 @@ config MTK_SVP
 config MTK_SVP_RAM_SIZE
 	int "MTK SVP RAM dram buffer size in MB"
 	depends on MTK_SVP
+	default 0
 
 config MTK_TUI_RAM_SIZE
 	int "MTK TUI SVP RAM dram buffer size in MB"
 	depends on MTK_SVP
 	default 0
 
+config MTK_AB_OTA_UPDATER
+	bool "Support Android A/B system updates"
+	default n
+
+config MTK_GROUP_ENABLE_VERITY
+	bool "Support enable dm verity for grouped switch"
+	default y
+	select BLK_DEV_MD
+	select MD_LINEAR
+	select DM_ANDROID_VERITY
+	select KEYS
+	select INTEGRITY_SIGNATURES
+	select SYSTEM_TRUSTED_KEYRING
+	select DM_VERITY
+	select X509_CERTIFICATE_PARSER
+	select PUBLIC_KEY_ALGO_RSA
+	select ASYMMETRIC_KEY_TYPE
+	select ASYMMETRIC_PUBLIC_KEY_SUBTYPE
+
+config SYSTEM_AS_ROOT
+	bool "Support system-as-root, which merges ramdisk into system image"
+	default y
+
 source "drivers/misc/mediatek/aee/Kconfig"
 source "drivers/misc/mediatek/atf_log/Kconfig"
 source "drivers/misc/mediatek/boot/Kconfig"
 source "drivers/misc/mediatek/boot_reason/Kconfig"
 source "drivers/misc/mediatek/chip/Kconfig"
- 
 source "drivers/misc/mediatek/devinfo/Kconfig"
 source "drivers/misc/mediatek/dynamic_boost/Kconfig"
 source "drivers/misc/mediatek/exm/Kconfig"
- 
 source "drivers/misc/mediatek/gud/Kconfig"
 source "drivers/misc/mediatek/ice_debug/Kconfig"
 source "drivers/misc/mediatek/log_store/Kconfig"
 source "drivers/misc/mediatek/masp/Kconfig"
- 
 source "drivers/misc/mediatek/mlog/Kconfig"
 source "drivers/misc/mediatek/mtprof/Kconfig"
 source "drivers/misc/mediatek/performance/Kconfig"
 source "drivers/misc/mediatek/ram_console/Kconfig"
 source "drivers/misc/mediatek/sched/Kconfig"
-source "drivers/misc/mediatek/secmem/Kconfig"
 source "drivers/misc/mediatek/selinux_warning/Kconfig"
 source "drivers/misc/mediatek/sysenv/Kconfig"
- 
 source "drivers/misc/mediatek/teei/Kconfig"
 source "drivers/misc/mediatek/trustzone/Kconfig"
-source "drivers/misc/mediatek/vow/Kconfig"
 source "drivers/misc/mediatek/watchpoint/Kconfig"
 source "drivers/misc/mediatek/rt-regmap/Kconfig"
-source "drivers/misc/mediatek/pd/Kconfig"
+
+config MTK_DM_VERITY_OFF
+	bool "Disable dm-verity"
+	default n
 
 endmenu    # Misc
 
```

## drivers/misc/mediatek/usb_c/Kconfig.rej
```kconfig
--- drivers/misc/mediatek/usb_c/Kconfig
+++ drivers/misc/mediatek/usb_c/Kconfig
@@ -66,6 +66,7 @@ config USB_C_SWITCH_MT6353
 	  PD and MHL alt mode are not supported.
 	  If unsure, say N.
 
+
 config TCPC_CLASS
 	bool "TypeC Port Controller Device Class"
 	select USB_C_SWITCH
@@ -105,12 +106,12 @@ config TCPC_RT1711H
 	  TypeC port Controller
 	  Driver
 
-config TCPC_RT5081
-	bool "Richtek RT1711H TypeC port Controller Driver"
+config TCPC_RT5081A
+	bool "Richtek RT5081A TypeC port Controller Driver"
 	depends on TCPC_CLASS
 	default n
 	help
-	  Say Y to enable Richtek RT5081
+	  Say Y to enable Richtek RT5081A
 	  TypeC port Controller
 	  Also Support Power Delivery
 	  Say N to disable
@@ -125,12 +126,3 @@ config USB_PD_VBUS_STABLE_TOUT
 	  for
 	  VBUS change
 	  stable
-
-config RT7207_ADAPTER
-	bool "Richtek RT7207 PD Adapter"
-	default n
-	help
-	  Say Y to enable
-	  Richtek RT7207
-	  PD Adapter
-	  Function.
```
